## conf/layer.conf
```bitbake
# meta-tegra210-mainline layer configuration

BBPATH .= ":${LAYERDIR}"

BBFILES += "${LAYERDIR}/recipes-*/*/*.bb \
            ${LAYERDIR}/recipes-*/*/*.bbappend"

BBFILE_COLLECTIONS += "tegra210-mainline"
BBFILE_PATTERN_tegra210-mainline = "^${LAYERDIR}/"
BBFILE_PRIORITY_tegra210-mainline = "6"

LAYERVERSION_tegra210-mainline = "1"
LAYERDEPENDS_tegra210-mainline = "core"
LAYERSERIES_COMPAT_tegra210-mainline = "wrynose"

# .wks lives in files/wic/ (default WKS search path in modern OE-core);
# WKS_FILE = "jetson-nano-sdimage.wks" resolves automatically.
```
